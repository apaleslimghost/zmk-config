## boards/shields/apaleslimghost/Kconfig.defconfig
```kconfig
if SHIELD_APALESLIMGHOST_LEFT

config ZMK_KEYBOARD_NAME
    default "apaleslimghost"

config ZMK_SPLIT_ROLE_CENTRAL
    default y

endif

if SHIELD_APALESLIMGHOST_LEFT || SHIELD_APALESLIMGHOST_RIGHT

config ZMK_SPLIT
    default y

endif
```

## boards/shields/apaleslimghost/Kconfig.shield
```kconfig
config SHIELD_APALESLIMGHOST_LEFT
    def_bool $(shields_list_contains,apaleslimghost_left)

config SHIELD_APALESLIMGHOST_RIGHT
    def_bool $(shields_list_contains,apaleslimghost_right)
```

## config/west.yml
```yaml
manifest:
  remotes:
    - name: zmkfirmware
      url-base: https://github.com/joelspadin
  projects:
    - name: zmk
      remote: zmkfirmware
      revision: debounce-rework
      import: app/west.yml
  self:
    path: config
```
